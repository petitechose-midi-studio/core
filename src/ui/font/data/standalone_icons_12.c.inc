// Auto-generated | standalone_icons | 12px | 4bpp | 2026-08-19 12:07
#include "config/PlatformCompat.hpp"

const uint8_t standalone_icons_12_bin[] PROGMEM = {
    0x30, 0x00, 0x00, 0x00, 0x68, 0x65, 0x61, 0x64, 0x01, 0x00, 0x00, 0x00, 0x03, 0x00, 0x0c, 0x00,
    0x09, 0x00, 0xfe, 0xff, 0x0a, 0x00, 0xfe, 0xff, 0x01, 0x00, 0xfe, 0xff, 0x09, 0x00, 0x00, 0x00,
    0x10, 0x00, 0x00, 0x00, 0x00, 0x04, 0x02, 0x04, 0x05, 0x01, 0x00, 0x00, 0x01, 0x00, 0x00, 0x00,
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    0xa2, 0x49, 0xdc, 0x16, 0xe0, 0xbe, 0x80, 0x00
};
const uint32_t standalone_icons_12_bin_len = 3384;
