// Auto-generated | standalone_icons | 16px | 4bpp | 2026-08-20 02:28
#include "config/PlatformCompat.hpp"

const uint8_t standalone_icons_16_bin[] PROGMEM = {
    0x30, 0x00, 0x00, 0x00, 0x68, 0x65, 0x61, 0x64, 0x01, 0x00, 0x00, 0x00, 0x03, 0x00, 0x10, 0x00,
    0x0c, 0x00, 0xfe, 0xff, 0x0d, 0x00, 0xfd, 0xff, 0x01, 0x00, 0xfe, 0xff, 0x0c, 0x00, 0x00, 0x00,
    0x10, 0x00, 0x00, 0x00, 0x00, 0x04, 0x03, 0x04, 0x06, 0x01, 0x00, 0x00, 0x01, 0x00, 0x00, 0x00,
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    0x11, 0x3f, 0x87, 0x80, 0x0c, 0xb7, 0x34, 0x81, 0x74, 0x1f, 0x32, 0x00
};
const uint32_t standalone_icons_16_bin_len = 4988;
