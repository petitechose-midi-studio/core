// Auto-generated | standalone_icons | 14px | 4bpp | 2026-08-19 12:07
#include "config/PlatformCompat.hpp"

const uint8_t standalone_icons_14_bin[] PROGMEM = {
    0x30, 0x00, 0x00, 0x00, 0x68, 0x65, 0x61, 0x64, 0x01, 0x00, 0x00, 0x00, 0x03, 0x00, 0x0e, 0x00,
    0x0b, 0x00, 0xfe, 0xff, 0x0b, 0x00, 0xfd, 0xff, 0x01, 0x00, 0xfe, 0xff, 0x0b, 0x00, 0x00, 0x00,
    0x10, 0x00, 0x00, 0x00, 0x00, 0x04, 0x03, 0x04, 0x05, 0x01, 0x00, 0x00, 0x01, 0x00, 0x00, 0x00,
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    0x00, 0xe7, 0xfe, 0xa0, 0xff, 0x05, 0x7f, 0x8c
};
const uint32_t standalone_icons_14_bin_len = 3976;
